#include <Adafruit_GFX.h>
#include <Adafruit_PCD8544.h>

static const unsigned char PROGMEM bikeBmp[]=
{
0xff,0xff,0xff,0xff,0xff,0xff,
0xff,0xff,0xff,0xff,0xff,0xff,
0xff,0xff,0xff,0xff,0xff,0xff,
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0xff,0xff,0xff,0xff,0xff,0xff
};


Adafruit_PCD8544 display = Adafruit_PCD8544(13, 11, 9, 10, 8);

void setup() {
    display.begin();
    display.cp437(true);
    display.setContrast(50); // установка контраста
    display.clearDisplay();
}

void loop() 
{
    display.clearDisplay();
    display.drawBitmap(0, 0, bikeBmp, 48, 48, BLACK);
//    display.drawBitmap(0, 20, bikeBmp, 20, 20, BLACK);
//    display.drawBitmap(0, 40, bikeBmp, 20, 20, BLACK);
    display.display();
    delay(500); // задержка в секунду
//  display.clearDisplay();
    
//    display.drawBitmap(50, 0, bikeBmp, 48, 48, BLACK);
//    display.display();
//    delay(1000);
//    display.clearDisplay();

    display.setTextColor(BLACK);
    display.setCursor(50,0);
    display.setTextSize(1);
    display.println(utf8rus("С"));
    delay(500); // задержка
    display.display();
    display.setCursor(50,10);
    display.println(utf8rus("новым"));
    delay(500); // задержка
    display.display();
    display.setCursor(50,20);
    display.println(utf8rus("годом"));
    delay(500); // задержка
    display.display();
    display.setCursor(50,30);
    display.println(utf8rus("ОСПАС"));
    delay(500); // задержка
    display.display();
    display.setCursor(50,40);
    display.println(utf8rus("ТН ДВ"));
    delay(500); // задержка
    display.display();
    delay(1000); // задержка
    display.clearDisplay();
//  display.clearDisplay();
    delay(1000); // 
}

/* Функция перевода UTF-8 to Windows-1251 */
String utf8rus(String source)
{
  int i,k;
  String target;
  unsigned char n;
  char m[2] = { '0', '\0' };

  k = source.length(); i = 0;

  while (i < k) {
    n = source[i]; i++;

    if (n >= 0xC0) {
      switch (n) {
        case 0xD0: {
          n = source[i]; i++;
          if (n == 0x81) { n = 0xA8; break; }
          if (n >= 0x90 && n <= 0xBF) n = n + 0x30;
          break;
        }
        case 0xD1: {
          n = source[i]; i++;
          if (n == 0x91) { n = 0xB8; break; }
          if (n >= 0x80 && n <= 0x8F) n = n + 0x70;
          break;
        }
      }
    }
    m[0] = n; target = target + String(m);
  }
return target;
}
